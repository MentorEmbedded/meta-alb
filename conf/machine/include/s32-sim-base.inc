## conf/machine/include/s32-sim-base.inc
```bitbake
require conf/machine/include/s32-base.inc

IMAGE_FSTYPES += "cpio.gz"
IMAGE_FSTYPES:remove = "flashimage"

KERNEL_DEFCONFIG ?= "s32gen1_defconfig"

UBOOT_CONFIG = "cpio"

VIRTUAL-RUNTIME:dev_manager = "busybox-mdev"
VIRTUAL-RUNTIME:login_manager = "busybox"
VIRTUAL-RUNTIME:init_manager = "busybox"
VIRTUAL-RUNTIME:initscripts = "initscripts"
VIRTUAL-RUNTIME:keymaps = "keymaps"
DISTRO_FEATURES_BACKFILL_CONSIDERED += "sysvinit"
DISTRO_FEATURES:append = " virtio "

SOC_FAMILY:append = ":gen1"
```

## conf/machine/s32g274a_emu.conf
```bitbake
#@TYPE: Machine
#@NAME: NXP S32G274A ZeBu EMULATOR
#@SOC: s32g274a
#@DESCRIPTION: Machine configuration for running the S32G274A ZeBu EMULATOR in 64-bit mode
#@MAINTAINER: Catalin Dan Udma <catalin-dan.udma@nxp.com>
# Copyright 2017-2019 NXP

require conf/machine/include/s32-gen1.inc

IMAGE_FSTYPES += "cpio.gz"

VIRTUAL-RUNTIME:dev_manager = "busybox-mdev"
VIRTUAL-RUNTIME:login_manager = "busybox"
VIRTUAL-RUNTIME:init_manager = "busybox"
VIRTUAL-RUNTIME:initscripts = "initscripts"
VIRTUAL-RUNTIME:keymaps = "keymaps"
DISTRO_FEATURES_BACKFILL_CONSIDERED += "sysvinit"
DISTRO_FEATURES:append = " virtio "

UBOOT_CONFIG = "sdcard"

KERNEL_DEVICETREE ?= "freescale/s32g274a-emu.dtb"
KERNEL_DEFCONFIG ?= "s32gen1_emu_defconfig"

UBOOT_DEFCONFIG = "s32g274a_emu_defconfig"
UBOOT_CONFIG[sdcard] = "${UBOOT_DEFCONFIG},,u-boot-nodtb.${UBOOT_SUFFIX}"

ITB_ROOTFS_TYPE = "cpio"

UBOOT_BOOTSPACE_OFFSET = "0"
UBOOT_BOOTSPACE_SEEK = "0"
```
